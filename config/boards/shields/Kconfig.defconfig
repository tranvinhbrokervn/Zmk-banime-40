## config/boards/shields/Kconfig.defconfig
```kconfig
# Copyright (c) 2024 The ZMK Contributors
# SPDX-License-Identifier: MIT

if SHIELD_BANIME40

# LVGL Configuration for OLED Display
if LVGL
config LV_Z_VDB_SIZE
    default 64

config LV_Z_DPI
    default 148

config LV_Z_BITS_PER_PIXEL
    default 1

choice LV_COLOR_DEPTH
    default LV_COLOR_DEPTH_1
endchoice

endif # LVGL

endif # SHIELD_BANIME40
```

## config/boards/shields/banime40/Kconfig.defconfig
```kconfig
# Copyright (c) 2024 The ZMK Contributors
# SPDX-License-Identifier: MIT

if SHIELD_BANIME40

# LVGL Configuration for OLED Display
if LVGL

config LV_Z_VDB_SIZE
    int "LVGL Virtual Display Buffer Size"
    default 64

config LV_Z_DPI
    int "LVGL Display DPI"
    default 148

config LV_Z_BITS_PER_PIXEL
    int "LVGL Bits Per Pixel"
    default 1

choice LV_COLOR_DEPTH
    prompt "LVGL Color Depth"
    default LV_COLOR_DEPTH_1
endchoice

endif # LVGL

# Display init priority for this shield
config ZMK_DISPLAY_INIT_PRIORITY
    int "Display init priority"
    default 81

endif # SHIELD_BANIME40
```

## config/boards/shields/banime40/Kconfig.shield
```kconfig
# Copyright (c) 2024 The ZMK Contributors
# SPDX-License-Identifier: MIT

config SHIELD_BANIME40
    def_bool $(shields_list_contains,banime40)
```

## config/west.yml
```yaml
manifest:
  remotes:
    - name: zmkfirmware
      url-base: https://github.com/zmkfirmware
  projects:
    - name: zmk
      remote: zmkfirmware
      revision: main
      import: app/west.yml
    - name: zmk-encoder-module
      path: modules/zmk-encoder-module
      url: https://github.com/tranvinhbrokervn/Zmk-banime-40/tree/c733da7624420b0a926ed2166f5202d598d0289a/zmk-encoder-module
      revision: +screen+rotary
  self:
    path: config
```

## zmk-encoder-module/app/dts/bindings/zmk/keymap.yaml
```yaml
description: |
  Allows defining a keymap composed of multiple layers

compatible: "zmk,keymap"

child-binding:
  description: "A layer to be used in a keymap"

  properties:
    display-name:
      type: string
      required: false
      description: The name of this layer to show on displays
    bindings:
      type: phandle-array
      required: true
    sensor-bindings:
      type: phandle-array
      required: false
    encoder-bindings:
      type: phandle-array
      required: false
      description: Bindings for encoder nodes
```
